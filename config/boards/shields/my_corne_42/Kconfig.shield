## config/boards/shields/my_corne_42/Kconfig.shield
```kconfig
config SHIELD_MY_CORNE_42_LEFT
    def_bool $(shields_list_contains,my_corne_42_left)

config SHIELD_MY_CORNE_42_RIGHT
    def_bool $(shields_list_contains,my_corne_42_right)
```

## config/boards/shields/yuanyang/Kconfig.defconfig
```kconfig
# Copyright (c) 2022 The ZMK Contributors
# SPDX-License-Identifier: MIT

if SHIELD_YUANYANG_LEFT

config ZMK_KEYBOARD_NAME
    default "YUANYANG"
    
config ZMK_SPLIT_ROLE_CENTRAL
    default y

endif

if SHIELD_YUANYANG_LEFT || SHIELD_YUANYANG_RIGHT

config ZMK_SPLIT
    default y

endif
```

## config/boards/shields/yuanyang/Kconfig.shield
```kconfig
# Copyright (c) 2022 The ZMK Contributors
# SPDX-License-Identifier: MIT

config SHIELD_YUANYANG_LEFT
    def_bool $(shields_list_contains,yuanyang_left)

config SHIELD_YUANYANG_RIGHT
    def_bool $(shields_list_contains,yuanyang_right)
```
