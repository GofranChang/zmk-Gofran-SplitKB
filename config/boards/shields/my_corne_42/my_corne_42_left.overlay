/*
 * My Corne 42 - 左半侧
 *
 * nice!nano v2 引脚映射 (Pro Micro 兼容):
 *   列(col): D4, C6, D7, E6, B4, B5  → gpio 引脚编号 0.29, 0.02, 1.15, 0.03, 0.28, 0.13
 *   行(row): D1, D0, D4, C6           → 根据你的 PCB 实际走线调整
 *
 * ⚠️ 以下引脚使用 Pro Micro 兼容编号，请根据你的 PCB 原理图修改！
 */

#include "my_corne_42.dtsi"

&kscan0 {
    col-gpios
        = <&pro_micro 4 GPIO_ACTIVE_HIGH>
        , <&pro_micro 5 GPIO_ACTIVE_HIGH>
        , <&pro_micro 6 GPIO_ACTIVE_HIGH>
        , <&pro_micro 7 GPIO_ACTIVE_HIGH>
        , <&pro_micro 8 GPIO_ACTIVE_HIGH>
        , <&pro_micro 9 GPIO_ACTIVE_HIGH>
        ;
    row-gpios
        = <&pro_micro 21 (GPIO_ACTIVE_HIGH | GPIO_PULL_DOWN)>
        , <&pro_micro 20 (GPIO_ACTIVE_HIGH | GPIO_PULL_DOWN)>
        , <&pro_micro 19 (GPIO_ACTIVE_HIGH | GPIO_PULL_DOWN)>
        , <&pro_micro 18 (GPIO_ACTIVE_HIGH | GPIO_PULL_DOWN)>
        ;
};
